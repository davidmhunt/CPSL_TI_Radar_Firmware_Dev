/**
 * @cliArgs --device "AM273x" --package "ZCE" --part "Default" --context "c66ss0" --product "MCU_PLUS_SDK_AM273x.evmAM273x@08.04.00"
 * @versions {"tool":"1.14.0+2667"}
 */

/**
 * Import the modules used in this configuration.
 */
const cbuff     = scripting.addModule("/drivers/cbuff/cbuff", {}, false);
const cbuff1    = cbuff.addInstance();
const csirx     = scripting.addModule("/drivers/csirx/csirx", {}, false);
const csirx1    = csirx.addInstance();
const csirx2    = csirx.addInstance();
const edma      = scripting.addModule("/drivers/edma/edma", {}, false);
const edma1     = edma.addInstance();
const edma2     = edma.addInstance();
const hwa       = scripting.addModule("/drivers/hwa/hwa", {}, false);
const hwa1      = hwa.addInstance();
const ipc       = scripting.addModule("/drivers/ipc/ipc");
const cache_c6x = scripting.addModule("/kernel/dpl/cache_c6x");
const debug_log = scripting.addModule("/kernel/dpl/debug_log");

/**
 * Write custom configuration values to the imported modules.
 */
cbuff1.$name = "CONFIG_CBUFF0";

csirx1.$name                                              = "CONFIG_CSIRX0";
csirx1.instOpenEnable                                     = false;
csirx1.dphy.$name                                         = "CONFIG_CSIRX_DPHY0";
csirx1.dphy.ddrClockInHz                                  = 300000000;
csirx1.complexio.$name                                    = "CONFIG_CSIRX_COMPLEXIO0";
csirx1.complexio.isAllLanesEnterULPM                      = true;
csirx1.complexio.isAllLanesExitULPM                       = true;
csirx1.common.$name                                       = "CONFIG_CSIRX_COMMON0";
csirx1.common.burstSize                                   = "CSIRX_BURST_SIZE_8X64";
csirx1.common.isOcpError                                  = true;
csirx1.common.isComplexioError                            = true;
csirx1.common.isFifoOverflow                              = true;
csirx1.common.commonCallback                              = "MmwDemo_csirxCommonCallback";
csirx1.common.combinedEndOfLineCallback                   = "MmwDemo_combinedEOLcallback";
csirx1.common.startOfFrameIntr0Callback                   = "mmwDemo_DPC_ObjectDetection_csirxSOF0callback";
csirx1.context[0].$name                                   = "CONFIG_CSIRX_CONTEXT0";
csirx1.context[0].userDefinedMapping                      = "CSIRX_USER_DEFINED_FORMAT_RAW8";
csirx1.context[0].isEndOfLinePulseEnabled                 = true;
csirx1.context[0].numLinesForIntr                         = 1;
csirx1.context[0].pingPongSwitchMode                      = "CSIRX_PING_PONG_LINE_SWITCHING";
csirx1.context[0].numLinesForLineBasedPingPongSwitching   = 1;
csirx1.context[0].numFramesForFrameBasedPingPongSwitching = 0;
csirx1.context[0].isFrameEndCodeDetect                    = true;
csirx1.context[0].isFrameStartCodeDetect                  = true;
csirx1.context[0].isEndOfFramePulseEnabled                = true;
csirx1.context[0].isPayloadChecksumEnable                 = true;
csirx1.context[0].isLineStartCodeDetect                   = true;
csirx1.context[0].isGenerateIntrEveryNumLinesForIntr      = false;

csirx2.$name                                              = "CONFIG_CSIRX1";
csirx2.instance                                           = "CSIRX B";
csirx2.instOpenEnable                                     = false;
csirx2.dphy.$name                                         = "CONFIG_CSIRX_DPHY1";
csirx2.dphy.ddrClockInHz                                  = 300000000;
csirx2.complexio.$name                                    = "CONFIG_CSIRX_COMPLEXIO1";
csirx2.complexio.isAllLanesEnterULPM                      = true;
csirx2.complexio.isAllLanesExitULPM                       = true;
csirx2.common.$name                                       = "CONFIG_CSIRX_COMMON1";
csirx2.common.burstSize                                   = "CSIRX_BURST_SIZE_8X64";
csirx2.common.isOcpError                                  = true;
csirx2.common.isComplexioError                            = true;
csirx2.common.isFifoOverflow                              = true;
csirx2.common.commonCallback                              = "MmwDemo_csirxCommonCallback";
csirx2.common.startOfFrameIntr0Callback                   = "mmwDemo_DPC_ObjectDetection_csirxSOF0callback";
csirx2.common.combinedEndOfLineCallback                   = "MmwDemo_combinedEOLcallback";
csirx2.context[0].$name                                   = "CONFIG_CSIRX_CONTEXT1";
csirx2.context[0].userDefinedMapping                      = "CSIRX_USER_DEFINED_FORMAT_RAW8";
csirx2.context[0].isEndOfFramePulseEnabled                = true;
csirx2.context[0].isPayloadChecksumEnable                 = true;
csirx2.context[0].pingPongSwitchMode                      = "CSIRX_PING_PONG_LINE_SWITCHING";
csirx2.context[0].numFramesForFrameBasedPingPongSwitching = 0;
csirx2.context[0].numLinesForLineBasedPingPongSwitching   = 1;
csirx2.context[0].isFrameEndCodeDetect                    = true;
csirx2.context[0].isFrameStartCodeDetect                  = true;
csirx2.context[0].isLineStartCodeDetect                   = true;
csirx2.context[0].numLinesForIntr                         = 1;
csirx2.context[0].isGenerateIntrEveryNumLinesForIntr      = false;
csirx2.context[0].isEndOfLinePulseEnabled                 = true;

edma1.$name                       = "CONFIG_EDMA0";
edma1.enableOwnQdmaChannelConfig  = false;
edma1.enableReservedChannelConfig = false;
edma1.instance                    = "EDMA_DSS_A";
edma1.edmaRmDmaCh[0].$name        = "CONFIG_EDMA_RM0";
edma1.edmaRmDmaCh[0].resourceType = scripting.forceWrite("ownDmaCh");
edma1.edmaRmDmaCh[0].endIndex     = 63;
edma1.edmaRmTcc[0].$name          = "CONFIG_EDMA_RM2";
edma1.edmaRmTcc[0].endIndex       = 63;
edma1.edmaRmParam[0].$name        = "CONFIG_EDMA_RM3";
edma1.edmaRmParam[0].endIndex     = 127;

edma2.$name                        = "CONFIG_EDMA1";
edma2.instance                     = "EDMA_DSS_B";
edma2.edmaRmDmaCh[0].resourceType  = scripting.forceWrite("ownDmaCh");
edma2.edmaRmDmaCh[0].$name         = "CONFIG_EDMA_RM1";
edma2.edmaRmDmaCh[0].endIndex      = 63;
edma2.edmaRmQdmaCh[0].$name        = "CONFIG_EDMA_RM4";
edma2.edmaRmQdmaCh[0].endIndex     = 0;
edma2.edmaRmTcc[0].$name           = "CONFIG_EDMA_RM5";
edma2.edmaRmTcc[0].endIndex        = 63;
edma2.edmaRmParam[0].$name         = "CONFIG_EDMA_RM6";
edma2.edmaRmParam[0].endIndex      = 127;
edma2.edmaRmReservedDmaCh[0].$name = "CONFIG_EDMA_RM7";

hwa1.$name = "CONFIG_HWA0";

ipc.vringNumBuf  = 1;
ipc.vringMsgSize = 1152;

cache_c6x.marRegionConfig.create(1);
cache_c6x.marRegionConfig[0].$name          = "kernel_dpl_cache_c6x_mar0";
cache_c6x.marRegionConfig[0].baseAddr       = 0x88000000;
cache_c6x.marRegionConfig[0].enableCache    = true;
cache_c6x.marRegionConfig[0].enablePrefetch = true;

debug_log.enableCssLog = false;
